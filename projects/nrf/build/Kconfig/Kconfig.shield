## projects/nrf/build/Kconfig/Kconfig.shield
```kconfig
osource "C:/ncs/custom/boards/shields/*/Kconfig.shield"
osource "C:/z_my_zephyr_projects/my_board/boards/shields/*/Kconfig.shield"
osource "D:/personalprojects/zephyr_boards/boards/shields/*/Kconfig.shield"
osource "C:/ncs/v3.0.2/nrf/boards/shields/*/Kconfig.shield"
```

## projects/nrf/build/nrf/Kconfig/Kconfig.shield.defconfig
```kconfig
osource "C:/ncs/custom/boards/shields/*/Kconfig.defconfig"
osource "C:/z_my_zephyr_projects/my_board/boards/shields/*/Kconfig.defconfig"
osource "D:/personalprojects/zephyr_boards/boards/shields/*/Kconfig.defconfig"
osource "C:/ncs/v3.0.2/nrf/boards/shields/*/Kconfig.defconfig"
```

## projects/nrf/v0_0_1/Kconfig/Kconfig.shield
```kconfig
osource "d:/projects/zephyr_boards/boards/shields/*/Kconfig.shield"
osource "C:/ncs/v3.0.2/nrf/boards/shields/*/Kconfig.shield"
```

## projects/nrf/v0_0_1/Kconfig/Kconfig.shield.defconfig
```kconfig
osource "d:/projects/zephyr_boards/boards/shields/*/Kconfig.defconfig"
osource "C:/ncs/v3.0.2/nrf/boards/shields/*/Kconfig.defconfig"
```

## projects/nrf/v0_0_1/Kconfig/boards/Kconfig
```kconfig
# Load Zephyr board Kconfig descriptions.
osource "D:/Projects/zephyr_boards/boards/Saki/nrf52840dk_minimal/Kconfig"
```

## projects/nrf/v0_0_1/Kconfig/boards/Kconfig.defconfig
```kconfig
# Load Zephyr board defconfig descriptions.
osource "D:/Projects/zephyr_boards/boards/Saki/nrf52840dk_minimal/Kconfig.defconfig"
```

## projects/nrf/v0_0_1/Kconfig/boards/Kconfig.nrf52840dk_minimal
```kconfig
# Load board Kconfig descriptions.
osource "D:/Projects/zephyr_boards/boards/Saki/nrf52840dk_minimal/Kconfig.nrf52840dk_minimal"
```

## projects/nrf/v0_0_1/Kconfig/boards/Kconfig.sysbuild
```kconfig
# Load Sysbuild board Kconfig descriptions.
osource "D:/Projects/zephyr_boards/boards/Saki/nrf52840dk_minimal/Kconfig.sysbuild"
```
